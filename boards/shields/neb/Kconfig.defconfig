## boards/shields/neb/Kconfig.defconfig
```kconfig
if SHIELD_NEB_LEFT

config ZMK_KEYBOARD_NAME
    default "neb"

config ZMK_SPLIT_ROLE_CENTRAL
    default y

endif # SHIELD_NEB_LEFT

if SHIELD_NEB_LEFT || SHIELD_NEB_RIGHT

config ZMK_SPLIT
    default y

endif # SHIELD_NEB_LEFT || SHIELD_NEB_RIGHT
```

## boards/shields/neb/Kconfig.shield
```kconfig
config SHIELD_NEB_LEFT
    def_bool $(shields_list_contains,neb_left)

config SHIELD_NEB_RIGHT
    def_bool $(shields_list_contains,neb_right)
```
